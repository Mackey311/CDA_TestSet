/*作成者：小原光二 小川牧葉　最新アップデート日：2020/6/23
 * 
 * Arduino IDEコンパイルオプション
 * ・ボード：Ardbox Family
 * ・Model：Ardbox analog
 * 
 * 電磁弁のチューブ接続について
 * ・1-5番ポート：渦輪生成用。
 * ・6-9番ポート：香りタンクチューブを接続
 * ・10番ポート：実験時のみ使用
 * 
 * 【使用方法】
 * CDAの香り選択、射出時間制御用スケッチ
 * ↓シリアル制御方法
 * シリアルポートに’f’を入力すると射出します
 * 時間条件を変更する場合はシリアルポートに8桁の数列を入力してください.
 * 入力する数列は[**|***|***](ポート番号00-09|開孔時間[msec]|閉孔時間[msec])です
 * ※※※※※※※※※※※※※※ ポート番号は1-10ではなく00-09です ※※※※※※※※※※※※※※※※※
 * 時間条件の時間解像度は3msecです。時間条件の閾値は0〜150msecです・
 * ループ関数の一番下の方にあるdelayを変更すると時間解像度を変更できます。
 * ※※※※※※※※※※※※※※スイッチボックスを使用しない場合は、setpar関数を一部改変してください。詳細は関数記述部分のコメントに書いてあります。※※※※※※※※※※※※※※
 * 
 * 【シリアル入力例】
 * 00000060（１番ポート（渦輪用１番目）の射出時間を0[msec]〜60[msec]に設定）
 * 01000060（２番ポート（渦輪用２番目）の射出時間を0[msec]〜60[msec]に設定）
 * 02000070（３番ポート（渦輪用３番目）の射出時間を0[msec]〜70[msec]に設定）
 * 03000080（４番ポート（渦輪用４番目）の射出時間を0[msec]〜80[msec]に設定）
 * 04000080（５番ポート（渦輪用５番目）の射出時間を0[msec]〜80[msec]に設定）
 * 06000030（７番ポート（香り用２番目）の射出時間を0[msec]〜60[msec]に設定）
 * f（射出）
 */

const int port[10]={4,8,12,3,5,6,9,10,11,13};//電磁弁ピン番号
const int button=18;//発射スイッチ（スイッチボックス使用時）
const int lever1=19;//香りスイッチ１（スイッチボックス使用時）
const int lever2=20;//香りスイッチ２（スイッチボックス使用時）
const int lever3=21;//香りスイッチ３（スイッチボックス使用時）
const int lever4=22;//香りスイッチ４（スイッチボックス使用時）

int data[3]={};//シリアル通信で受信したデータを(ポート番号,開孔時間,閉孔時間)に分割して格納
char cdata[9]={};//シリアル通信で受信したchar型生データを格納
long num=0;//受信したchar型生データをlong型に変換
int snum=0;//受信文字数をカウント

#define TIME_DEV 3//射出時感の最小単位　3msec

int val=0;//射出スイッチ信号を読み取り
int old_val=0;//前回のループでの射出スイッチ信号を保存
int val1=0;//香りスイッチ信号を読み取り
int val2=0;
int val3=0;
int val4=0;
int old_val1=0;//前回のループでの香りスイッチ信号を保存
int old_val2=0;
int old_val3=0;
int old_val4=0;

int flag =0;//待機状態と射出状態を判断
               
int ch[10][51]={};//射出パラメータ設定用配列 MAX150msec = 50 x TIME_DEV 
               //{1,2,3,4,5,6,7,8,9,0,1,2,3,4,5,6,7,8,9,0,1,2,3,4,5,6,7,8,9,0,1,2,3,4,5,6,7,8,9,0,1,2,3,4,5,6,7,8,9,0}51番目の0は開孔したままにならないように
int par[10][51]={{0,0,0,0,0,0,0,0,0,0,0,0,0,0,0,0,0,0,0,0,0,0,0,0,0,0,0,0,0,0,0,0,0,0,0,0,0,0,0,0,0,0,0,0,0,0,0,0,0,0,0},//1要素につき3msec()
                 {0,0,0,0,0,0,0,0,0,0,0,0,0,0,0,0,0,0,0,0,0,0,0,0,0,0,0,0,0,0,0,0,0,0,0,0,0,0,0,0,0,0,0,0,0,0,0,0,0,0,0},//配列の中身が1であれば対応するバルブを開放
                 {0,0,0,0,0,0,0,0,0,0,0,0,0,0,0,0,0,0,0,0,0,0,0,0,0,0,0,0,0,0,0,0,0,0,0,0,0,0,0,0,0,0,0,0,0,0,0,0,0,0,0},//0なら閉孔
                 {0,0,0,0,0,0,0,0,0,0,0,0,0,0,0,0,0,0,0,0,0,0,0,0,0,0,0,0,0,0,0,0,0,0,0,0,0,0,0,0,0,0,0,0,0,0,0,0,0,0,0},//初期値では1-5番のポートを60msec射出するように設定
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                 {0,0,0,0,0,0,0,0,0,0,0,0,0,0,0,0,0,0,0,0,0,0,0,0,0,0,0,0,0,0,0,0,0,0,0,0,0,0,0,0,0,0,0,0,0,0,0,0,0,0,0}};
int mscnt=0;//射出時何msec射出したかカウント（配列何番目まで射出したかカウント）
char baf;
int i,j,k,l;

void setup() {

  // put your setup code here, to run once:
  Serial.begin(9600);
  for(i=0;i<10;i++){
    pinMode(port[i],OUTPUT);
  }
  pinMode(button,INPUT);
  pinMode(lever1,INPUT);
  pinMode(lever2,INPUT);
  pinMode(lever3,INPUT);
  pinMode(lever4,INPUT);

  setpar();//各チャンネルに初期値パラメータ設定
}

void loop() {
  // put your main code here, to run repeatedly:

  if(flag==0){//待機中
    mscnt=0;//待機中は射出時間カウントは常に0
    val=digitalRead(button);//射出スイッチ読み込み
    val1=digitalRead(lever1);//香りスイッチ読み込み
    val2=digitalRead(lever2);
    val3=digitalRead(lever3);
    val4=digitalRead(lever4);
    if((val1!=old_val1)||(val2!=old_val2)||(val3!=old_val3)||(val4!=old_val4)){//香りスイッチのON/OFFが切り替わった場合各チャンネルにパラメータ設定
      setpar();//各チャンネルパラメータ設定
      delay(10);
    }
    if((val==HIGH)&&(old_val==LOW)){//射出スイッチが押された場合、次ループで射出状態に入るようフラグを１に
      flag=1; 
      delay(100);
    }
    
    
    else if(Serial.available() > 0){//シリアル通信によって射出、もしくは射出時間条件変更する。シリアルポートから受信できるデータがある場合にこのif分に入る
      baf = Serial.read();//バッファに受信した1byteを格納
      //Serial.print(baf);
      switch(baf){         //できれば一回のループでまとめてパースできるようにして欲しい
        case 'f'://受信したデータがfの場合次ループで射出状態に入るようフラグを１に
          flag=1;
          Serial.println("射出します");
          print();
          delay(100);
          break;
        case 'c':   //ここでコードをクリヤする
         Serial.println();
         clear();
         setpar();
         Serial.println("入力をクリアします");
         print();
         break;
        case '\n'://シリアル通信で最後に入る改行文字の例外処理
          //Serial.println("改行文字");
          if(snum != 8){
            Serial.println();
            Serial.println("パラメータ変更時は8桁の数列を入力してください.[**|***|***](ポート番号00-09|開孔時間[msec]|閉孔時間[msec])");
            //Serial.println("射出したい時は'f'を、クリアしたい時は'c'を入力してください");
            snum = 0;
            for(i=0;i<8;i++){
              cdata[i] = NULL;
            }
          }
          break;
        default ://数字を受信した場合、受信データを格納
          cdata[snum]=baf;
          snum++;//受信データをカウント
          break;
      }
    }




    if(snum == 8){//配列定義部.8桁読み取ればOK
      for(i=0;i<8;i++){
        Serial.print(cdata[i]);//受信データを印字
      }
      Serial.println();
      num = atol(cdata);//受信データを数値に変換　//三つとも文字列に切り離して、intに個別に変換
      snum = 0;
      data[0]=num / 1000000;//数値をポート番号、 //＜−−−−ダサイ、割り算厳禁
      data[1]=(num % 1000000) / 1000;//開孔時間、
      data[2]=num % 1000;//閉孔時間に分割
      Serial.print("【条件設定】ポート: ");Serial.print(data[0]);
      Serial.print(",射出開始時間(m/s): ");Serial.print((data[1]/TIME_DEV)*TIME_DEV); // Defineつかえ
      Serial.print(",射出終了時間(m/s): ");Serial.println((data[2]/TIME_DEV)*TIME_DEV);
      settime();//各パラメータ設定
      setpar();//各チャンネルにパラメータを設定
      delay(100);
    }
  }
  else{
//↓射出
    air_fire(port,ch,mscnt);//射出
    mscnt++;//何msec射出したか（パラメータ配列をどこまで読み取ったか）カウント。
    delay(TIME_DEV);
    if(mscnt==51){//配列を全て読み終えてバルブを閉じたら待機状態に戻る
      flag=0;
    }
  }
    old_val1=val1;//現ループのスイッチの状態を保存
    old_val2=val2;
    old_val3=val3;
    old_val4=val4;
    old_val=val; 
}

void settime(){
  //clear(); //これをはずす
  print();
  for(i=data[1]/TIME_DEV;i<data[2]/TIME_DEV;i++){//新しい条件
    par[data[0]][i]=1;//新しい条件を格納
  }
  print();
}

void print(){
  Serial.println();
  for(k=0;k<10;k++){
    Serial.println();
    Serial.print("ポート番号: ");Serial.print(k);Serial.print(" : ");
    for(l=0;l<51;l++){
      Serial.print(par[k][l]);
    }
  }
}

void clear(){
  for(j=0;j<11;j++){
    for(i=0;i<50;i++){ //一回初期化
      par[j][i]=0; //全てのポートのパラメータを一度全て０に
    }
  }
}

void setpar(){//各チャンネル射出時間配列にパラメータを設定
  for(i=0;i<10;i++){//渦輪生成用ポート（1-5番）にパラメータを設定
    for(j=0;j<50;j++){
      ch[i][j]=par[i][j];
    }
  }
  //6番目以降のポートはスイッチボックスを使用する場合、スイッチがONでないとパラメータを設定しないようにしてあります。
  //シリアル制御のみを使用する場合は、この関数の以下の記述をコメントアウトし、上のfor文の繰り返し条件をi<10に変更してください。
  /*if(val1==HIGH){//香りスイッチがONであれば香り用ポートにパラメータ設定
    for(j=0;j<50;j++){
      ch[5][j]=par[5][j];
    }
  }
  if(val1==LOW){//香りスイッチがOFFであれば香り用ポートにOFF設定
     for(j=0;j<50;j++){
      ch[5][j]=0;
    }
  }
  if(val2==HIGH){//香りスイッチがONであれば香り用ポートに設定
    for(j=0;j<50;j++){
      ch[6][j]=par[6][j];
    }
  }
  if(val2==LOW){//香りスイッチがOFFであれば香り用ポートにOFF設定
     for(j=0;j<50;j++){
      ch[6][j]=0;
    }
  }
  if(val3==HIGH){//香りスイッチがONであれば香り用ポートに設定
    for(j=0;j<50;j++){
      ch[7][j]=par[7][j];
    }
  }
  if(val3==LOW){//香りスイッチがOFFであれば香り用ポートにOFF設定
     for(j=0;j<50;j++){
      ch[7][j]=0;
    }
  }
  if(val4==HIGH){//香りスイッチがONであれば香り用ポートに設定
    for(j=0;j<50;j++){
      ch[8][j]=par[8][j];
    }
  }
  if(val4==LOW){//香りスイッチがOFFであれば香り用ポートにOFF設定
     for(j=0;j<50;j++){
      ch[8][j]=0;
    }
  }
  for(j=0;j<50;j++){//現状香りデモの際、10番目のポートは使用していないが、実験用に設定してあります。
    ch[9][j]=par[9][j];
  }*/
}

void air_fire(int pin[], int ch[10][51], int mscnt){
    for(i=0;i<10;i++){//各チャンネルの時間条件配列を読み取り、1であれば開孔、0であれば閉孔する。
      if(ch[i][mscnt]==1){
        digitalWrite(pin[i],HIGH);
      }
      else if(ch[i][mscnt]==0){
        digitalWrite(pin[i],LOW);
      }
    }
  }
  
